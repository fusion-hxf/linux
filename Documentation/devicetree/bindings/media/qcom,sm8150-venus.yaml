## Documentation/devicetree/bindings/media/qcom,sm8150-venus.yaml
```yaml
# SPDX-License-Identifier: (GPL-2.0 OR BSD-2-Clause)
%YAML 1.2
---
$id: http://devicetree.org/schemas/media/qcom,sm8150-venus.yaml#
$schema: http://devicetree.org/meta-schemas/core.yaml#

title: Qualcomm SM8150 Venus video encode and decode accelerator

maintainers:
  - Stanimir Varbanov <stanimir.varbanov@linaro.org>

description: |
  The SM8150 video accelerator contains the first-generation Iris VPU.  It
  uses the HFI 6xx protocol with the Iris1 register and reset layout.

allOf:
  - $ref: qcom,venus-common.yaml#

properties:
  compatible:
    const: qcom,sm8150-venus

  clocks:
    maxItems: 5

  clock-names:
    items:
      - const: iface
      - const: bus
      - const: bus1
      - const: core
      - const: vcodec0_core

  power-domains:
    minItems: 3
    maxItems: 3

  power-domain-names:
    items:
      - const: venus
      - const: vcodec0
      - const: mx

  interconnects:
    minItems: 3
    maxItems: 3

  interconnect-names:
    items:
      - const: cpu-cfg
      - const: video-mem
      - const: video-processor

  iommus:
    maxItems: 1

  operating-points-v2: true

  opp-table:
    type: object

  resets:
    minItems: 4
    maxItems: 4

  reset-names:
    items:
      - const: bus
      - const: core
      - const: bus0
      - const: bus1

required:
  - compatible
  - power-domain-names
  - interconnects
  - interconnect-names
  - iommus
  - resets
  - reset-names

unevaluatedProperties: false
```
